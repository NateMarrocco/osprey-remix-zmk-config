## config/boards/shields/osprey-remix/Kconfig.shield
```kconfig
config SHIELD_OSPREY_REMIX_DONGLE
    def_bool $(shields_list_contains,osprey-remix_dongle)
```

## config/boards/shields/osrpey-remix/Kconfig.defconfig
```kconfig
if SHIELD_OSRPEY_REMIX
config ZMK_KEYBOARD_NAME
    default "Osprey"
config ZMK_SPLIT
    default y
config ZMK_SPLIT_ROLE_CENTRAL
    default n
config BT_MAX_CONN
    default 6
config BT_MAX_PAIRED
    default 6
endif
```

## config/boards/shields/osrpey-remix/Kconfig.shield
```kconfig
config SHIELD_OSRPEY_REMIX_DONGLE
    def_bool $(shields_list_contains,osrpey-remix_dongle)

config SHIELD_OSRPEY_REMIX
    def_bool $(shields_list_contains,osrpey-remix)
```

## config/west.yml
```yaml
manifest:
  remotes:
    - name: zmkfirmware
      url-base: https://github.com/zmkfirmware
  projects:
    - name: zmk
      remote: zmkfirmware
      revision: 26246da
      import: app/west.yml
  self:
    path: config
```
